## configs/compute_defconfig
```kconfig
CONFIG_ARCH_ARM64=y
CONFIG_MMU=y
CONFIG_UART=y
CONFIG_VFS=y
CONFIG_HRTIMER=y
# CONFIG_SPI is not set
CONFIG_DMA_BUF=y
# CONFIG_DSOT_MODEM is not set
```

## configs/dsot_defconfig
```kconfig
CONFIG_ARCH_ARM64=y
CONFIG_MMU=y
CONFIG_UART=y
CONFIG_VFS=y
CONFIG_HRTIMER=y
CONFIG_SPI=y
CONFIG_SPI_S32G3=y
CONFIG_DMA_BUF=y
CONFIG_DSOT_MODEM=y
# CONFIG_SPI_RK3399 is not set
```

## configs/phone_defconfig
```kconfig
CONFIG_ARCH_ARM64=y
CONFIG_MMU=y
CONFIG_UART=y
CONFIG_VFS=y
CONFIG_HRTIMER=y
CONFIG_SPI=y
CONFIG_SPI_RK3399=y
CONFIG_DMA_BUF=y
# CONFIG_SPI_S32G3 is not set
# CONFIG_DSOT_MODEM is not set
```
